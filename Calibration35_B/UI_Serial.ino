// Yes判定 ------------------------------------------------
void Judgment_of_Yes() {
//Serial.println("Judgment_of_Yes();");

  Yes_No = 0;
  char Str_Num[5];
  Str_Num[0] = ' ';Str_Num[1] = ' ';Str_Num[2] = ' ';Str_Num[3] = ' ';

  for ( int i = 0 ; i < 2 ; i++ ) {                           // max:2文字ためる
    while(Serial.available() == 0) {
      delay(50);// 0.05秒待つ
    }
    Str_Num[i] = Serial.read();
    Serial.write(Str_Num[i]);
    if ((Str_Num[i] == LF) || (Str_Num[i] == CR)) {
      break;
    }
  }
  String_trim(Str_Num);                                       // 文字列のｽﾍﾟｰｽを取って文字配列にｺﾋﾟｰする
  Str_DEC_conversion(Copy_Str);                               // 文字列を数値(10進数)に変換する
  Yes_No = Str_DEC;
  while(Serial.available() > 0) {
    char Not_needed = Serial.read();
    Serial.write(Not_needed);
  }
  Serial.println();
}


// 空白で文字列の長さを揃える ------------------------------------------------
void Space_print(char * _Name) {

  String_length(_Name);                                       // 文字列の長さを求める

  for (int i = 12 ; i > Str_length ; i--) {
    Serial.print(' ');
  }
}


// 線 ------------------------------------------------
void line_minus() {
  Serial.println(F("--------------------------------------------------------"));
}


// 線 ------------------------------------------------
void line_minus_space() {
  Serial.println(F("- - - - - - - - - - - - - - - - - - - - - - - - - - - - "));
}


// 線 ------------------------------------------------
void line_equal() {
  Serial.println(F("========================================================"));
}


// 線 ------------------------------------------------
void line_period() {
  Serial.println(F("........................................................"));
}


// 線 ------------------------------------------------
void line_Slash() {
  Serial.println(F("////////////////////////////////////////////////////////"));
}


// 線 ------------------------------------------------
void line_asterisk() {
  Serial.println(F("********************************************************"));
}


// 線 ------------------------------------------------
void line_sharp() {
  Serial.println(F("########################################################"));
}


// 短い線 ------------------------------------------------
void S_line_minus() {
  Serial.println(F("--------------------------------"));
}


// 短い線 ------------------------------------------------
void S_line_minus_space() {
  Serial.println(F("- - - - - - - - - - - - - - - - "));
}


// 短い線 ------------------------------------------------
void S_line_equal() {
  Serial.println(F("================================"));
}


// 短い線 ------------------------------------------------
void S_line_period() {
  Serial.println(F("................................"));
}


// 短い線 ------------------------------------------------
void S_line_Slash() {
  Serial.println(F("////////////////////////////////"));
}


// 短い線 ------------------------------------------------
void S_line_asterisk() {
  Serial.println(F("********************************"));
}


// 短い線 ------------------------------------------------
void S_line_sharp() {
  Serial.println(F("################################"));
}


//
