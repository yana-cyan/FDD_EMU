////////////////////////////////////////////////////////////////////////////////////////////
/// ﾌﾗｯｼｭﾒﾓﾘ･ﾃﾞｰﾀ部 //////////////////////////////////////////////////////////////////////////
////////////////////////////////////////////////////////////////////////////////////////////
const char Ascii_font[] PROGMEM = {             // 最大253952byteのFlashﾒﾓﾘｰへ(低速)
//0x20-0x2F
0x00, 0x00, 0x00, 0x00, 0x00,// []
0x00, 0x00, 0xF2, 0x00, 0x00,// [!]
0x00, 0xE0, 0x00, 0xE0, 0x00,// [\]
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0x04, 0x08, 0x10, 0x20, 0x40,// [/]

//0x30-0x3F
0x7C, 0x8A, 0x92, 0xA2, 0x7C,// [0]
0x00, 0x42, 0xFE, 0x02, 0x00,// [1]
0x42, 0x86, 0x8A, 0x92, 0x62,// [2]
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0x40, 0x80, 0x8A, 0x90, 0x60,// [?]

//0x40-0x4F
0x4C, 0x92, 0x9E, 0x82, 0x7C,// [@]
0x7E, 0x88, 0x88, 0x88, 0x7E,// [A]
0xFE, 0x92, 0x92, 0x92, 0x6C,// [B]
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0x7C, 0x82, 0x82, 0x82, 0x7C,// [O]

//0x50-0x5F
0xFE, 0x90, 0x90, 0x90, 0x60,// [P]
0x7C, 0x82, 0x8A, 0x84, 0x7A,// [Q]
0xFE, 0x90, 0x98, 0x94, 0x62,// [R]
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0x02, 0x02, 0x02, 0x02, 0x02,// [_]

//0x60-0x6F
0x00, 0x80, 0x40, 0x20, 0x00,// [`]
0x04, 0x2A, 0x2A, 0x2A, 0x1E,// [a]
0xFE, 0x12, 0x22, 0x22, 0x1C,// [b]
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0x1C, 0x22, 0x22, 0x22, 0x1C,// [o]

//0x70-0x7F
0x3E, 0x28, 0x28, 0x28, 0x10,// [p]
0x10, 0x28, 0x28, 0x18, 0x3E,// [q]
0x3E, 0x10, 0x20, 0x20, 0x10,// [r]
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0x00, 0x00, 0x00, 0x00, 0x00 // []
};

const char Kana_font[] PROGMEM = {             // 最大253952byteのFlashﾒﾓﾘｰへ(低速)
//0xA0-0xAF
0x00, 0x00, 0x00, 0x00, 0x00,// []
0x0E, 0x0A, 0x0E, 0x00, 0x00,// [｡]
0x00, 0x00, 0xF0, 0x80, 0x80,// [｢]
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0x18, 0x00, 0x1A, 0x02, 0x1C,// [ｯ]

//0xB0-0xBF
0x10, 0x10, 0x10, 0x10, 0x10,// [ｰ]
0x80, 0x82, 0xBC, 0x90, 0xE0,// [ｱ]
0x08, 0x10, 0x3E, 0x40, 0x80,// [ｲ]
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0x60, 0x12, 0x02, 0x04, 0x78,// [ｿ]

//0xC0-0xCF
0x10, 0x62, 0x52, 0x4C, 0x78,// [ﾀ]
0x50, 0x52, 0x7C, 0x90, 0x10,// [ﾁ]
0x70, 0x00, 0x72, 0x04, 0x78,// [ﾂ]
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0x40, 0x48, 0x44, 0x4A, 0x70,// [ﾏ]

//0xD0-0xDF
0x00, 0x54, 0x54, 0x54, 0x02,// [ﾐ]
0x1C, 0x24, 0x44, 0x04, 0x0E,// [ﾑ]
0x02, 0x14, 0x08, 0x14, 0x60,// [ﾒ]
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0xE0, 0xA0, 0xE0, 0x00, 0x00 // [ﾟ]
};


////////////////////////////////////////////////////////////////////////////////////////////
/// 処理部 //////////////////////////////////////////////////////////////////////////////////
////////////////////////////////////////////////////////////////////////////////////////////
// RGBｽｸﾘｰﾝ出力(英数ｶﾅ) ------------------------------------------------
// UTF-8の半角ｶﾅ(3byte) -> ｼﾌﾄJISの半角ｶﾅ(1byte)に変換
// UTF-8の半角ｶﾅは0xEFで始まり、2byte目に0xBDが続く場合3byte目はそのまま
// 2byte目に0xBEが続く場合は3byte目に0x40を足す
// 0xffbaffddffc6ffc1ffca20ffbeffb6ffb221 -> "ｺﾝﾆﾁﾊ ｾｶｲ!"
// 0xbaddc6c1ca20beb6b221 -> "ｺﾝﾆﾁﾊ ｾｶｲ!"
void ANK_print(char * INP_String, int x, int y, int csize, uint16_t TXT_Color) {
  if (INP_String[0] == NULL) {
    return;
  }
//Serial.print(F("INP_String : "));Hex_char_rtn(INP_String);    //debug
  int Tbl_point, i, i1, i2, i3, j, X1, Y1, PX, cnt1, cnt2;
  byte TFT_String[128];                                       // TFTｶﾀｶﾅ表示文字列編集用
  byte Byte_code;                                             // 文字列を1byteずつ処理する
  byte Char_code;                                             // 文字列を1byteずつ処理する
  byte Font_data;                                             // ﾌｫﾝﾄの一部分
  byte KANA_cnt = 0;                                          // UTF-8の半角ｶﾅ3byteの一部かとうか
  boolean Add_flg = false;                                    // 3byte目に0x40足すかどうか
  String_length(INP_String);                                  // 文字列の長さを求める
//Serial.print("Str_length(INP_String) : ");Serial.println(Str_length, DEC);
  j = 0;
  for (i = 0 ; i < Str_length ; i++) {
    if (Add_flg == true) {
      Byte_code = byte(INP_String[i]) + 0x40;
      TFT_String[j] = char(Byte_code);
      j++;
      KANA_cnt = 0;
      Add_flg = false;
    } else {
      Char_code = INP_String[i];
      switch (Char_code) {
      case 0xBD:                                              // 0xBD(189) ｶﾀｶﾅ3byteの2byte目
        if (KANA_cnt == 1) {
          KANA_cnt = 2;
          break;
        } else if (KANA_cnt == 2) {
          TFT_String[j] = Char_code;
          j++;
          KANA_cnt = 0;
        }
        break;
      case 0xBE:                                              // 0xBE(190) ｶﾀｶﾅ3byteの2byte目
        if (KANA_cnt == 1) {
          Add_flg = true;
          KANA_cnt = 2;
          break;
        } else if (KANA_cnt == 2) {
          TFT_String[j] = Char_code;
          j++;
          KANA_cnt = 0;
        }
        break;
      case 0xEF:                                              // 0xEF(239) ｶﾀｶﾅ3byteの1byte目
        KANA_cnt = 1;
        break;
      default:
        if (KANA_cnt == 0) {
          TFT_String[j] = Char_code;
          j++;
          break;
        } else if (KANA_cnt == 2) {
          TFT_String[j] = Char_code;
          j++;
          KANA_cnt = 0;
        }
      }
    }
  }
  TFT_String[j] = NULL;
//Serial.print("j : ");Serial.println(j, DEC);
  PX = x;
//Serial.print(F("TFT_String : "));Hex_char_rtn(TFT_String);    //debug
  String_length(TFT_String);                                  // 文字列の長さを求める
//Serial.print("Str_length(TFT_String) : ");Serial.println(Str_length, DEC);
  for ( i3 = 0 ; i3 < Str_length ; i3++ ) {
    Char_code = TFT_String[i3];                               // 文字列を1byteずつ処理する
    if ((Char_code > 0x1F) && (Char_code < 0x80)) {           // 英数文字を出力
      for ( i2 = 0 ; i2 < 5 ; i2++ ) {                        // ﾌｫﾝﾄの横5ﾄﾞｯﾄ
        Tbl_point = (Char_code - 0x20) * 5 + i2;              // 0x20-0x7Fの文字ｺｰﾄﾞをﾌｫﾝﾄﾃｰﾌﾞﾙに合わせる
        Font_data =  pgm_read_byte_near(Ascii_font + Tbl_point);// 1byte読み込み
        for ( i1 = 0 ; i1 < 8 ; i1++ ) {                      // ﾌｫﾝﾄの縦8ﾄﾞｯﾄ
          // 対象ﾋﾞｯﾄが[1]ならﾄﾞｯﾄを打つ
          if (Font_data & (B10000000 >> i1)) {
            switch (csize) {                                  // 文字の大きさでﾄﾞｯﾄを変える
            case 1:                                           // ﾄﾞｯﾄが点
              X1 = PX + i2;
              Y1 = y + i1;
              DSP.drawPixel(X1, Y1, TXT_Color);
              break;
            case 2:                                           // ﾄﾞｯﾄが四角の外枠
              X1 = PX + 2 * i2;
              Y1 = y + 2 * i1;
              DSP.drawRect(X1, Y1, 2, 2, TXT_Color);
              break;
            default:                                          // ﾄﾞｯﾄが四角の塗りつぶし
              X1 = PX + csize * i2;
              Y1 = y + csize * i1;
              DSP.fillRect(X1, Y1, csize, csize, TXT_Color);
            }
          }
        }
      }
    }
    if ((Char_code > 0x9F) && (Char_code < 0xE0)) {           // ｶﾅ文字を出力
      for ( i2 = 0 ; i2 < 5 ; i2++ ) {                        // ﾌｫﾝﾄの横5ﾄﾞｯﾄ
        Tbl_point = (Char_code - 0xA0) * 5 + i2;              // 0xA0-0xDFの文字ｺｰﾄﾞをﾌｫﾝﾄﾃｰﾌﾞﾙに合わせる
        Font_data =  pgm_read_byte_near(Kana_font + Tbl_point);// 1byte読み込み
        for ( i1 = 0 ; i1 < 8 ; i1++ ) {                      // ﾌｫﾝﾄの縦8ﾄﾞｯﾄ
          // 対象ﾋﾞｯﾄが[1]ならﾄﾞｯﾄを打つ
          if (Font_data & (B10000000 >> i1)) {
            switch (csize) {                                  // 文字の大きさでﾄﾞｯﾄを変える
            case 1:                                           // ﾄﾞｯﾄが点
              X1 = PX + i2;
              Y1 = y + i1;
              DSP.drawPixel(X1, Y1, TXT_Color);
              break;
            case 2:                                           // ﾄﾞｯﾄが四角の外枠
              X1 = PX + 2 * i2;
              Y1 = y + 2 * i1;
              DSP.drawRect(X1, Y1, 2, 2, TXT_Color);
              break;
            default:                                          // ﾄﾞｯﾄが四角の塗りつぶし
              X1 = PX + csize * i2;
              Y1 = y + csize * i1;
              DSP.fillRect(X1, Y1, csize, csize, TXT_Color);
            }
          }
        }
      }
    }
    switch (csize) {                                          // 文字の大きさでﾄﾞｯﾄを変える
    case 1:                                                   // ﾄﾞｯﾄが点
      PX = PX + 6;
      break;
    case 2:                                                   // ﾄﾞｯﾄが四角の外枠
      PX = PX + 12;
      break;
    default:                                                  // ﾄﾞｯﾄが四角の塗りつぶし
      PX = PX + csize * 6;
    }
  }
}


/* 16進数文字列(debug用) ------------------------------------------------
void Hex_char_rtn(byte * INP_String) {
  for ( int cnt = 0; cnt < 256; cnt++ ) {
    if (INP_String[cnt] == NULL) {
      break;
    }
    byte H_byte = highByte(INP_String[cnt]);
    Serial.print(H_byte, HEX);
    byte L_byte = lowByte(INP_String[cnt]);
    Serial.print(L_byte, HEX);
    Serial.print(' ');
  }
  Serial.println();
}
*/

//
